/*********************************************************************************************************
* 模块名称: WakeUp.c
* 摘    要: 
* 当前版本: 1.0.0
* 作    者: 
* 完成日期: 2018年03月01日
* 内    容:
* 注    意: none                                                                  
**********************************************************************************************************
* 取代版本: 
* 作    者:
* 完成日期: 
* 修改内容:
* 修改文件: 
*********************************************************************************************************/

/*********************************************************************************************************
*                                              包含头文件
*********************************************************************************************************/
#include "WakeUp.h"
#include "SysTick.h"
#include "OLED.h"
 
/*********************************************************************************************************
*                                              宏定义
*********************************************************************************************************/

/*********************************************************************************************************
*                                              枚举结构体定义
*********************************************************************************************************/

/*********************************************************************************************************
*                                              内部变量
*********************************************************************************************************/

/*********************************************************************************************************
*                                              内部函数声明
*********************************************************************************************************/
static void SysStandby(void);

/*********************************************************************************************************
*                                              内部函数实现
*********************************************************************************************************/
/*********************************************************************************************************
* 函数名称: Sys_Standby
* 函数功能: 配置LED的GPIO，作为系统运行指示灯 
* 输入参数: void 
* 输出参数: void
* 返 回 值: void
* 创建日期: 2018年03月01日
* 注    意:
*********************************************************************************************************/
static void SysStandby(void)
{  
  OLEDClear();
	RCC_APB1PeriphClockCmd(RCC_APB1Periph_PWR, ENABLE);	//使能PWR外设时钟
	PWR_WakeUpPinCmd(ENABLE);                           //使能唤醒管脚功能
	PWR_EnterSTANDBYMode();	                            //进入待命（STANDBY）模式 		 
}

/*********************************************************************************************************
*                                              API函数实现
*********************************************************************************************************/

/*********************************************************************************************************
* 函数名称: Sys_Enter_Standby
* 函数功能: 系统进入待机模式
* 输入参数: void 
* 输出参数: void
* 返 回 值: void
* 创建日期: 2018年03月01日
* 注    意:
*********************************************************************************************************/
void SysEnterStandby(void)
{			 
	RCC_APB2PeriphResetCmd(0X01FC, DISABLE);	//复位所有IO口
  
	SysStandby();
}

/*********************************************************************************************************
* 函数名称: EXTI0_IRQHandler
* 函数功能: 中断,检测到PA0脚的一个上升沿.	  
* 输入参数: void 
* 输出参数: void
* 返 回 值: void
* 创建日期: 2018年03月01日
* 注    意: 中断线0线上的中断检测
*********************************************************************************************************/
void EXTI0_IRQHandler(void)
{ 		    		    				     		    
	EXTI_ClearITPendingBit(EXTI_Line0); // 清除LINE10上的中断标志位	
  
	if(CheckWKUP())//关机?
	{		  
		SysEnterStandby();  
	}
} 

/*********************************************************************************************************
* 函数名称: Check_WKUP
* 函数功能: 检测WKUP脚的信号
* 输入参数: void 
* 输出参数: void
* 返 回 值: 1:连续按下3s以上;0:错误的触发	
* 创建日期: 2018年03月01日
* 注    意:
*********************************************************************************************************/
u8 CheckWKUP(void) 
{
	u16 t = 0;	//记录按下的时间
  u32 delay = 0;
  
	PBout(5) = 0; //亮灯DS0 
  
	while(1)
	{
		if(WKUP_KD)
		{
			t++;			//已经按下了 
      
      while(delay != 12000000)
      {
        delay++;
      }
      
			if(t >= 100)		//按下超过3秒钟
			{
				PBout(5) = 0;	 	//点亮DS0 
        
				return 1; 	//按下3s以上了
			}
		}
    else 
		{ 
			PBout(5) = 1;
      
			return 0; //按下不足3秒
		}
	}
} 

/*********************************************************************************************************
* 函数名称: WKUP_Init
* 函数功能: WKUP唤醒初始化
* 输入参数: void 
* 输出参数: void
* 返 回 值: void
* 创建日期: 2018年03月01日
* 注    意: PA0
*********************************************************************************************************/
void InitWakeUp(void)
{	
  GPIO_InitTypeDef  GPIO_InitStructure;  		  
	NVIC_InitTypeDef  NVIC_InitStructure;
	EXTI_InitTypeDef  EXTI_InitStructure;

	RCC_APB2PeriphClockCmd(RCC_APB2Periph_GPIOA | RCC_APB2Periph_AFIO, ENABLE);//使能GPIOA和复用功能时钟

	GPIO_InitStructure.GPIO_Pin  = GPIO_Pin_0;	 //PA.0
	GPIO_InitStructure.GPIO_Mode = GPIO_Mode_IPD;//上拉输入
	GPIO_Init(GPIOA, &GPIO_InitStructure);	//初始化IO
  //使用外部中断方式
	GPIO_EXTILineConfig(GPIO_PortSourceGPIOA, GPIO_PinSource0);	//中断线0连接GPIOA.0

  EXTI_InitStructure.EXTI_Line    = EXTI_Line0;	//设置按键所有的外部线路
	EXTI_InitStructure.EXTI_Mode    = EXTI_Mode_Interrupt;			//设外外部中断模式:EXTI线路为中断请求
	EXTI_InitStructure.EXTI_Trigger = EXTI_Trigger_Rising;  //上升沿触发
 	EXTI_InitStructure.EXTI_LineCmd = ENABLE;
	EXTI_Init(&EXTI_InitStructure);	// 初始化外部中断

	NVIC_InitStructure.NVIC_IRQChannel = EXTI0_IRQn; //使能按键所在的外部中断通道
	NVIC_InitStructure.NVIC_IRQChannelPreemptionPriority = 2; //先占优先级2级
	NVIC_InitStructure.NVIC_IRQChannelSubPriority = 2; //从优先级2级
	NVIC_InitStructure.NVIC_IRQChannelCmd = ENABLE; //使能外部中断通道
	NVIC_Init(&NVIC_InitStructure); //根据NVIC_InitStruct中指定的参数初始化外设NVIC寄存器

	if(CheckWKUP() == 0) 
  {
    SysStandby();    //不是开机,进入待机模式  
  }
}
