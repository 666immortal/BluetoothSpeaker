/*********************************************************************************************************
* 模块名称: ExeCode.c
* 摘    要: 
* 当前版本: 1.0.0
* 作    者: 
* 完成日期: 
* 内    容:
* 注    意: none                                                                  
**********************************************************************************************************
* 取代版本: 
* 作    者:
* 完成日期: 
* 修改内容:
* 修改文件: 
*********************************************************************************************************/

/*********************************************************************************************************
*                                              包含头文件
*********************************************************************************************************/
#include "ExeCode.h"
#include "UART.h"
#include "RTC.h"

/*********************************************************************************************************
*                                              宏定义
*********************************************************************************************************/

/*********************************************************************************************************
*                                              枚举结构体定义
*********************************************************************************************************/

/*********************************************************************************************************
*                                              内部变量
*********************************************************************************************************/
extern u8 AlarmState;

/*********************************************************************************************************
*                                              内部函数声明
*********************************************************************************************************/
static u8 ChrtoDec(char chr);

/*********************************************************************************************************
*                                              内部函数实现
*********************************************************************************************************/
/*********************************************************************************************************
* 函数名称: chrtodec
* 函数功能: 字符转换完成一会对应的数值
* 输入参数: void 
* 输出参数: void
* 返 回 值: 字符转换完成一会对应的数值
* 创建日期: 2018年03月01日
* 注    意: 
*********************************************************************************************************/
static u8 ChrtoDec(char chr)
{
  u8 value = 0;
  
  //先全部将小写转换为大写
  if((chr >= 'a')&&(chr <= 'z'))
  {
    chr = chr - 32;
  }
  
  //将字符转化成相应的数字
  if((chr>='0')&&(chr<='9'))
  {
    value = chr - 48;
  }
  else if((chr >= 'A')&&(chr <= 'Z'))
  {
    value = chr - 65 + 10;
  }
  
  return value;
}
 
/*********************************************************************************************************
*                                              API函数实现
*********************************************************************************************************/
/*********************************************************************************************************
* 函数名称: InitExeCode
* 函数功能: 初始化ExeCode
* 输入参数: void 
* 输出参数: void
* 返 回 值: void
* 创建日期: 2018年03月01日
* 注    意: 
*********************************************************************************************************/
void  InitExeCode(void)
{
  
}

/*********************************************************************************************************
* 函数名称: ExeBTCode
* 函数功能: 处理蓝牙接受到的命令
* 输入参数: void 
* 输出参数: void
* 返 回 值: void
* 创建日期: 2018年03月01日
* 注    意: 
*********************************************************************************************************/
void ExeBTCode(u8* code)
{ 
  u16  result1 = 0;
  u16  result2 = 0;
  u16  result3 = 0;
  
  printf("The first char of Code is '%c'\r\n", code[0]);
  
  if(code[0] == '0')
  {
    RTC_ITConfig(RTC_IT_ALR, DISABLE);
    AlarmState = 0;
    printf("Close Alarm\r\n");
  }
  else if(code[0] == '1')
  {
    printf("Open Alarm\r\n");

    result1 = (code[1] - 48) * 10 + (code[2] - 48);
    result2 = (code[3] - 48) * 10 + (code[4] - 48);
    
    SetAlarm(result1, result2);
    
    printf("Set %d:%d\r\n", result1, result2);
  }
  else if(code[0] == '2')
  {
    printf("Modulate FM\r\n");
    //接着处理后面的数据
    result1 = (code[1] - 48) * 1000 + (code[2] - 48) * 100 + (code[3] -48) *10 + (code[4] - 48);
    
    printf("result : %d\r\n", result1);
    printf("Set FM: %0.1f\r\n", result1 / 10.0);
  }
  else if(code[0] == '3')
  {
    printf("Deal with Lamp\r\n");
    
    result1 = ChrtoDec(code[1]) * 16 + ChrtoDec(code[2]);
    result2 = ChrtoDec(code[3]) * 16 + ChrtoDec(code[4]);
    result3 = ChrtoDec(code[5]) * 16 + ChrtoDec(code[6]);
    
    printf("red: %d, green: %d, blue: %d\r\n", result1, result2, result3);
  }
  else
  {
    printf("Error Code!\r\n");
  }
}
